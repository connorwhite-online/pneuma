## CMakeLists.txt
```
# nRF Connect SDK (Zephyr) application for the Pneuma wake island.
# Build with: west build -b nrf52840dk/nrf52840 firmware/wake-island
cmake_minimum_required(VERSION 3.20.0)

find_package(Zephyr REQUIRED HINTS $ENV{ZEPHYR_BASE})
project(pneuma_wake_island)

target_sources(app PRIVATE
	src/main.c
	src/wakeword.c
	src/button.c
	src/power.c
	src/uart_link.c
)
```

## prj.conf
```kconfig
# Pneuma wake-island Zephyr config (scaffold — expand during bring-up).
CONFIG_GPIO=y
CONFIG_SERIAL=y
CONFIG_UART_INTERRUPT_DRIVEN=y

# PDM mic for wake-word capture.
# CONFIG_AUDIO=y
# CONFIG_AUDIO_DMIC=y

# BLE for one-time provisioning (see docs/PROVISIONING.md).
# CONFIG_BT=y
# CONFIG_BT_PERIPHERAL=y

# Low-power idle (enable once the loop is IRQ-driven).
# CONFIG_PM=y
# CONFIG_PM_DEVICE=y
```

## src/main.c
```c
/*
 * Pneuma wake-island firmware (nRF52840, Zephyr / nRF Connect SDK).
 *
 * Always-on co-processor: listen for the wake word / button, power up the Linux
 * session SoC on demand, hand off over UART, then power it back down. This is
 * what keeps the power- and heat-hungry tier off ~99% of the time
 * (see docs/ARCHITECTURE.md §1 and docs/PROTOCOL.md).
 *
 * STATUS: scaffold. Builds against the nRF Connect SDK toolchain (not part of
 * this repo's CI). Module bodies are stubs marked TODO.
 */
#include <zephyr/kernel.h>

#include "pneuma.h"
#include "wakeword.h"
#include "button.h"
#include "power.h"
#include "uart_link.h"

int main(void)
{
	wakeword_init();
	button_init();
	power_init();
	uart_link_init();

	for (;;) {
		enum wake_reason reason = WAKE_NONE;

		if (wakeword_detected()) {
			reason = WAKE_WORD;
		} else {
			button_event(&reason); /* sets reason if a button fired */
		}

		if (reason != WAKE_NONE) {
			power_soc_on();              /* assert SOC_EN -> boot session tier */
			uart_link_send_wake(reason); /* tell the SoC why we woke */
			uart_link_wait_for_sleep();  /* block until the SoC says SLEEP */
			power_soc_off();             /* cut the session tier */
		}

		/* TODO: replace polling with IRQ/event-driven low-power idle so the
		 * island truly sips µA between wakes. */
		k_msleep(10);
	}

	return 0;
}
```

## src/button.c
```c
#include "button.h"

/*
 * TODO: configure the button GPIO with an interrupt (Zephyr gpio + gpio_callback)
 * and classify tap / double-tap / long-press, mapping to WAKE_BUTTON_TAP,
 * WAKE_VISUAL (e.g. long-press = "look at this"), WAKE_BUTTON_LONG.
 */

void button_init(void)
{
	/* TODO: gpio_pin_configure_dt + interrupt callback. */
}

bool button_event(enum wake_reason *reason)
{
	(void)reason;
	/* TODO: drain the gesture queue; set *reason and return true if one fired. */
	return false;
}
```

## src/button.h
```c
#ifndef PNEUMA_BUTTON_H
#define PNEUMA_BUTTON_H

#include <stdbool.h>
#include "pneuma.h"

void button_init(void);

/* If a button gesture occurred, set *reason and return true. */
bool button_event(enum wake_reason *reason);

#endif /* PNEUMA_BUTTON_H */
```

## src/pneuma.h
```c
/*
 * Shared types for the Pneuma wake-island firmware.
 */
#ifndef PNEUMA_H
#define PNEUMA_H

/* Why the device woke. Mirrors crate::hal::WakeReason on the session side and
 * the WAKE message in docs/PROTOCOL.md. */
enum wake_reason {
	WAKE_NONE = 0,
	WAKE_WORD,
	WAKE_BUTTON_TAP,
	WAKE_BUTTON_LONG,
	WAKE_VISUAL,
};

#endif /* PNEUMA_H */
```

## src/power.c
```c
#include "power.h"

/*
 * TODO: drive the SOC_EN GPIO into the PMIC / load switch that gates the session
 * tier. Add sequencing/debounce so the SoC boots cleanly and is only cut after
 * it has acked SLEEP over the UART link.
 */

void power_init(void)
{
	/* TODO: configure SOC_EN GPIO as output, default low (session tier off). */
}

void power_soc_on(void)
{
	/* TODO: set SOC_EN high. */
}

void power_soc_off(void)
{
	/* TODO: set SOC_EN low. */
}
```

## src/power.h
```c
#ifndef PNEUMA_POWER_H
#define PNEUMA_POWER_H

void power_init(void);

/* Assert SOC_EN: boot/resume the Linux session SoC + permit modem power. */
void power_soc_on(void);

/* Deassert SOC_EN: cut the session tier (call only after the SoC acks SLEEP). */
void power_soc_off(void);

#endif /* PNEUMA_POWER_H */
```

## src/uart_link.c
```c
#include "uart_link.h"

/*
 * TODO: implement the line/TLV protocol from docs/PROTOCOL.md over a Zephyr UART
 * device (async or interrupt API):
 *   TX: "WAKE reason=wakeword|button ...", "BATT level=NN"
 *   RX: "READY", "STATE ...", "SLEEP"
 * The island also owns instant UX cues (wake chime / LED) before the SoC boots.
 */

void uart_link_init(void)
{
	/* TODO: get UART device, configure baud, set up RX callback. */
}

void uart_link_send_wake(enum wake_reason reason)
{
	(void)reason;
	/* TODO: format and write the WAKE line. */
}

void uart_link_wait_for_sleep(void)
{
	/* TODO: block (with timeout) until a SLEEP line is received. */
}
```

## src/uart_link.h
```c
#ifndef PNEUMA_UART_LINK_H
#define PNEUMA_UART_LINK_H

#include "pneuma.h"

/* Control link to the session SoC (see docs/PROTOCOL.md). */
void uart_link_init(void);

/* Send "WAKE reason=..." to the SoC. */
void uart_link_send_wake(enum wake_reason reason);

/* Block until the SoC sends "SLEEP". */
void uart_link_wait_for_sleep(void);

#endif /* PNEUMA_UART_LINK_H */
```

## src/wakeword.c
```c
#include "wakeword.h"

/*
 * TODO: wire the PDM mic (nrfx PDM driver) into a small KWS model.
 * Options: a DS-CNN via TFLite-Micro + CMSIS-NN on the nRF52840, or offload to a
 * Syntiant NDP120 front-end (<1 mW) and just read its detect line here.
 * For now this is a stub that never triggers.
 */

void wakeword_init(void)
{
	/* TODO: init PDM, load model, start the inference task. */
}

bool wakeword_detected(void)
{
	/* TODO: return true on a confident "Hey Pneuma" detection. */
	return false;
}
```

## src/wakeword.h
```c
#ifndef PNEUMA_WAKEWORD_H
#define PNEUMA_WAKEWORD_H

#include <stdbool.h>

/* Always-on keyword spotting on the PDM mic. */
void wakeword_init(void);

/* True once when "Hey Pneuma" is detected since the last call. */
bool wakeword_detected(void);

#endif /* PNEUMA_WAKEWORD_H */
```
